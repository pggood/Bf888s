// bitbang spi on standard spi pins
#define clk_pin 13
#define dat_pin 12
#define ncs_pin 10
static const byte start[][3] PROGMEM = {
     {0xea,0x0,0xa},
     {0xe0,0x80,0x0},
     {0xe,0xdf,0xfd},
     {0xe,0xdf,0xfc}
};
static const byte  initalise[] PROGMEM = {0x2,0x0,0x0,0xb5,0x25,0x8,0xcc,0x2,0x1d,0xb8,0x88,0x7,0xe7,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0x80,0x0};
static const byte finish[][3] PROGMEM = {
     {0xe0,0xa0,0x0},
     {0x50,0x90,0x20},
     {0x58,0x9a,0x3a},
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     {0x54,0xff,0xff}
};
static const byte RX_reset[3] PROGMEM = {0xE0,0x80,0x00};
static const byte RX[3] PROGMEM = {0xE0,0xE0,0x00};
static const byte 12Khz[3] PROGMEM = {0x02,0x80,0x00};
bool Initalise(){
  pinMode(clk_pin, OUTPUT);
  pinMode(dat_pin, OUTPUT);
  pinMode(ncs_pin, OUTPUT);
  uint8_t temp;

  for (byte i = 0; i < sizeof(initalise) - 1; i++) { 
  digitalWrite(ncs_pin, 0);
    for (byte j = 0; j<8; j++) {
      temp = ((pgm_read_word_near(&initalise[i]) & (0x80 >> j)) != 0);
      digitalWrite(clk_pin, 0); 
      digitalWrite(dat_pin, temp);
      digitalWrite(clk_pin, 1); 
    }
  }
  digitalWrite(clk_pin, 0); 
  digitalWrite(ncs_pin, 1);

    for (byte h = 0; h < sizeof(finish)/3; h++) {
     
      digitalWrite(ncs_pin, 0);
      
      for (byte i = 0; i < 3; i++) {
        for (byte j = 0; j<8; j++) {
          temp = ((pgm_read_word_near(&finish[h][i]) & (0x80 >> j)) != 0);
          digitalWrite(clk_pin, 0); 
          digitalWrite(dat_pin, temp);
          digitalWrite(clk_pin, 1);
        } 
     }
     digitalWrite(clk_pin, 0);
     digitalWrite(ncs_pin, 1); 
  }
}
  
int8_t HSreadWord(uint8_t devAddr, uint8_t regAddr, uint16_t *data)
{
  //return I2Cdev::readWord(devAddr, regAddr, data);
  
  uint8_t temp;
  uint16_t temp_dat;
  // bitbang for great justice!
  *data = 0;
  pinMode(dat_pin, OUTPUT);
  regAddr = regAddr | (1 << 7);
  
  digitalWrite(devAddr, 0); //PORTC &= ~(1<<1); //devAddr used as chip select
  for (int i = 0; i < 8; i++) {
    temp = ((regAddr & (0x80 >> i)) != 0);
    digitalWrite(clk_pin, 0); //PORTC &= ~(1<<5); //
    digitalWrite(dat_pin, temp);
    digitalWrite(clk_pin, 1); //PORTC |= (1<<5); //
  }
  // change direction of dat_pin
  pinMode(dat_pin, INPUT); // DDRC &= ~(1<<4); //
  for (int i = 15; i >= 0; i--) {
    digitalWrite(clk_pin, 0); //PORTC &= ~(1<<5); //
    digitalWrite(clk_pin, 1); //PORTC |= (1<<5); //
    temp_dat = digitalRead(dat_pin); //((PINC & (1<<4)) != 0);
    temp_dat = temp_dat << i;
    *data |= temp_dat;
  }
  digitalWrite(devAddr, 1); //PORTC |= (1<<1);// CS
  
  return 1;
}
bool HSwriteWord(uint8_t devAddr, uint8_t regAddr, uint16_t data)
{
  //return I2Cdev::writeWord(devAddr, regAddr, data);
  
  uint8_t temp_reg;
  uint16_t temp_dat;
  
  //digitalWrite(13, HIGH);
  
  // bitbang for great justice!
  pinMode(dat_pin, OUTPUT);
  regAddr = regAddr & ~(1 << 7);
  
  digitalWrite(devAddr, 0); // PORTC &= ~(1<<1); //CS
  for (int i = 0; i < 8; i++) {
    temp_reg = ((regAddr & (0x80 >> i)) != 0);
    digitalWrite(clk_pin, 0); //PORTC &= ~(1<<5); //
    digitalWrite(dat_pin, regAddr & (0x80 >> i));
    digitalWrite(clk_pin, 1); // PORTC |= (1<<5); //
  }
  for (int i = 0; i < 16; i++) {
    temp_dat = ((data & (0x8000 >> i)) != 0);
    digitalWrite(clk_pin, 0); //PORTC &= ~(1<<5); //
    digitalWrite(dat_pin, temp_dat);
    digitalWrite(clk_pin, 1); // PORTC |= (1<<5); //
  }
  
  digitalWrite(devAddr, 1); //PORTC |= (1<<1); //CS
  
  return true;
}
void setup() {
  
  uint8_t temp;
  Serial.begin(9600);
  digitalWrite(ncs_pin, 1);
  delay(100);
  digitalWrite(ncs_pin, 0);
    for (byte h = 0; h < sizeof(start)/3; h++) {
      digitalWrite(ncs_pin, 0);
      for (byte i = 0; i < 3; i++) {
        for (byte j = 0; j<8; j++) {
          temp = ((pgm_read_word_near(&start[h][i]) & (0x80 >> j)) != 0);
          digitalWrite(clk_pin, 0); 
          digitalWrite(dat_pin, temp);
          digitalWrite(clk_pin, 1);
        } 
     }
     digitalWrite(clk_pin, 0);
     digitalWrite(ncs_pin, 1);
  }
  
 delay(3);

  Initalise();
  delay(95);
  Initalise();

  // put your setup code here, to run once:

}

void loop() {
  // put your main code here, to run repeatedly:

}
